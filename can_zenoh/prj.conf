## CMakeLists.txt
```
# SPDX-License-Identifier: Apache-2.0

cmake_minimum_required(VERSION 3.28.0)

find_package(Zephyr REQUIRED HINTS $ENV{ZEPHYR_BASE})
project(can_zenoh_gateway)

target_sources(app PRIVATE src/main.c)
```

## Kconfig
```
source "Kconfig.zephyr"

menu "CAN-Zenoh gateway"

config APP_ZENOH_BAUDRATE
	int "Zenoh UART baud rate"
	default 115200

config APP_ZENOH_KEY_PREFIX
	string "Zenoh key prefix"
	default "can"
	help
	  The gateway publishes CAN input to <prefix>/<CAN ID>/rx and subscribes
	  to <prefix>/*/tx for CAN output. IDs use three lowercase hex digits
	  without a 0x prefix.

endmenu
```

## prj.conf
```kconfig
# zenoh-pico: serial client with bidirectional pub/sub
CONFIG_ZENOH_PICO=y
CONFIG_ZENOH_PICO_LINK_SERIAL=y
CONFIG_ZENOH_PICO_MULTI_THREAD=y
CONFIG_ZENOH_PICO_PUBLICATION=y
CONFIG_ZENOH_PICO_SUBSCRIPTION=y
CONFIG_ZENOH_PICO_QUERY=n
CONFIG_ZENOH_PICO_QUERYABLE=n
CONFIG_ZENOH_PICO_RAWETH_TRANSPORT=n
CONFIG_ZENOH_PICO_LINK_TCP=n
CONFIG_ZENOH_PICO_LINK_UDP_UNICAST=n
CONFIG_ZENOH_PICO_LINK_UDP_MULTICAST=n
CONFIG_ZENOH_PICO_MULTICAST_TRANSPORT=n
CONFIG_ZENOH_PICO_UNICAST_TRANSPORT=y
CONFIG_ZENOH_PICO_UNICAST_PEER=n
CONFIG_ZENOH_PICO_SCOUTING=n
CONFIG_ZENOH_PICO_LINK_WS=n

# zenoh-pico's Zephyr port uses pthreads and the system heap.
CONFIG_POSIX_API=y
CONFIG_MAIN_STACK_SIZE=4096
CONFIG_HEAP_MEM_POOL_SIZE=65536
CONFIG_ENTROPY_GENERATOR=y
CONFIG_TEST_RANDOM_GENERATOR=y
CONFIG_GPIO=y
CONFIG_CAN=y

CONFIG_MAX_PTHREAD_MUTEX_COUNT=16
CONFIG_MAX_PTHREAD_COND_COUNT=8

CONFIG_SERIAL=y
CONFIG_UART_INTERRUPT_DRIVEN=y

# Never send logs to the UART carrying the Zenoh framing protocol.
CONFIG_LOG=y
CONFIG_LOG_DEFAULT_LEVEL=3
CONFIG_USE_SEGGER_RTT=y
CONFIG_LOG_BACKEND_RTT=n
CONFIG_LOG_BACKEND_UART=n
CONFIG_LOG_PRINTK=n
CONFIG_UART_CONSOLE=n
CONFIG_CONSOLE=y
CONFIG_RTT_CONSOLE=y
CONFIG_PRINTK=y

CONFIG_NETWORKING=y
```

## boards/nucleo_c562re.overlay
```dts
/ {
	aliases {
		zenoh-uart = &usart2;
	};
};

&usart2 {
	current-speed = <115200>;
	status = "okay";
};
```

## src/main.c
```c
/*
 * Copyright (c) 2016 Open-RnD Sp. z o.o.
 * Copyright (c) 2020 Nordic Semiconductor ASA
 *
 * SPDX-License-Identifier: Apache-2.0
 *
 * NOTE: If you are looking into an implementation of button events with
 * debouncing, check out `input` subsystem and `samples/subsys/input/input_dump`
 * example instead.
 */

#include <zephyr/kernel.h>
#include <zephyr/device.h>
#include <zephyr/drivers/can.h>
#include <zephyr/drivers/gpio.h>
#include <zephyr/sys/util.h>
#include <zephyr/sys/printk.h>

#include <zenoh-pico.h>

#define SLEEP_TIME_MS	1
#define CAN_MESSAGE_ID_SELF   0x28
#define CAN_MESSAGE_ID_TARGET 0x28
#define CAN_RX_QUEUE_SIZE     16
#define ZENOH_SUBSCRIBE_QUEUE_SIZE     16
#define LOCATOR_SIZE 96
#define KEY_SIZE 96
#define COMM_WORK_QUEUE_STACK_SIZE 1024
#define COMM_WORK_QUEUE_PRIORITY 5
#define APP_ZENOH_KEY_PREFIX "can"

K_MSGQ_DEFINE(can_rx_queue, sizeof(uint32_t), CAN_RX_QUEUE_SIZE, sizeof(uint32_t));
K_MSGQ_DEFINE(zenoh_sub_queue, sizeof(uint32_t), ZENOH_SUBSCRIBE_QUEUE_SIZE, sizeof(uint32_t));

/*
 * デバイスツリーのsw0 のエイリアスをボタンとして使う。必須。
 */
#define SW0_NODE	DT_ALIAS(sw0)
#if !DT_NODE_HAS_STATUS_OKAY(SW0_NODE)
#error "Unsupported board: sw0 devicetree alias is not defined"
#endif
static const struct gpio_dt_spec button = GPIO_DT_SPEC_GET_OR(SW0_NODE, gpios,
							      {0});
static struct gpio_callback button_cb_data;
static struct k_work button_work;
static struct k_work can_rx_work;
static struct k_work zenoh_publish_work;

/**
 * デバイスツリーで led0のエイリアスが定義されていればそれを使う。オプション。
 */
static struct gpio_dt_spec led = GPIO_DT_SPEC_GET_OR(DT_ALIAS(led0), gpios,
						     {0});

static const struct device *const can_dev = DEVICE_DT_GET(DT_CHOSEN(zephyr_canbus));
static const struct device *const zenoh_uart_dev = DEVICE_DT_GET(DT_ALIAS(zenoh_uart));

static z_owned_session_t session;

static void publish_status(uint32_t msgid);

/**
 * LEDを反転して状態を取得する
 * @param led 操作対象のGPIO
 * @return LEDの状態
 */
static bool toggle_led(struct gpio_dt_spec *led)
{
	int led_state = 0;

	if (gpio_pin_get_dt(led) == 0) {
		led_state = 1;
	} else {
		led_state = 0;
	}

	(void)gpio_pin_set_dt(led, led_state);
	return led_state;
}

/* 16進数の文字を数値にする */
static int hex_digit(char value)
{
	if (value >= '0' && value <= '9') {
		return value - '0';
	}
	if (value >= 'a' && value <= 'f') {
		return value - 'a' + 10;
	}
	if (value >= 'A' && value <= 'F') {
		return value - 'A' + 10;
	}

	return -EINVAL;
}

/**
 * keyからcan idを抽出する.
 * key は "<prefix>/nnn/tx"の形式. e.g. "can/028/tx" この場合 0x028 = 40
 */
static int can_id_from_key(const char *key, size_t key_len, uint32_t *id)
{
	const char *prefix = APP_ZENOH_KEY_PREFIX;
	const size_t prefix_len = strlen(prefix);

	if (key_len != prefix_len + sizeof("/000/tx") - 1 ||
	    memcmp(key, prefix, prefix_len) != 0 || key[prefix_len] != '/' ||
	    memcmp(&key[prefix_len + 4], "/tx", 3) != 0) {
		return -EINVAL;
	}

	*id = 0;
	for (size_t i = prefix_len + 1; i < prefix_len + 4; ++i) {
		const int digit = hex_digit(key[i]);

		if (digit < 0) {
			return -EINVAL;
		}
		*id = (*id << 4) | (uint32_t)digit;
	}

	return *id <= CAN_STD_ID_MASK ? 0 : -EINVAL;
}

/**
 * 1バイトのcanメッセージを送信
 * @param canid CAN ID
 */
void send_status_can_msg(uint32_t canid)
{
	struct can_frame frame = {0};
	int ret;

	frame.id = canid;
	frame.dlc = 0;

	ret = can_send(can_dev, &frame, K_NO_WAIT, NULL, NULL);
	if (ret != 0) {
		printk("Zenoh -> CAN failed for 0x%03x (%d)\n", frame.id, ret);
		return;
	}
	printk("Zenoh -> CAN: 0x%03x (%u bytes)\n", frame.id, frame.dlc);
}

/**
 * CANメッセージ受信時に遅延実行で行う処理
 * キューに入れたデータを取得して、自分のIDが指定されていたら
 * LEDを反転する。
 */
static void can_rx_work_handler(struct k_work *work)
{
	uint32_t received_id;

	ARG_UNUSED(work);

	while (k_msgq_get(&can_rx_queue, &received_id, K_NO_WAIT) == 0) {
		if (led.port) {
			if (received_id == CAN_MESSAGE_ID_SELF) {
				(void)toggle_led(&led);
			}
		}

		publish_status(received_id);

		printk("CAN message received with ID 0x%03x\n", received_id);
	}
}

/**
 * Zenoh sampleを受け取ったときの動作
 * idの情報をキューに入れる
 */
static void can_received(const struct device *dev, struct can_frame *frame,
			 void *user_data)
{
	uint32_t id = frame->id;

	if (k_msgq_put(&can_rx_queue, &id, K_NO_WAIT) != 0) {
		return;
	}

	(void)k_work_submit(&can_rx_work);
}

static void publish_status(uint32_t msgid)
{
	char key[KEY_SIZE];
	z_view_keyexpr_t keyexpr;
	z_owned_bytes_t payload;
	int ret;

	ret = snprintf(key, sizeof(key), "%s/%03x/rx", APP_ZENOH_KEY_PREFIX, msgid);
	if (ret < 0 || (size_t)ret >= sizeof(key)) {
		printk("CAN -> Zenoh key is too long\n");
		return;
	}
	z_view_keyexpr_from_str_unchecked(&keyexpr, key);
	if (z_bytes_copy_from_buf(&payload, NULL, 0) < 0) {
		printk("CAN -> Zenoh payload allocation failed\n");
		return;
	}
	if (z_put(z_loan(session), z_loan(keyexpr), z_move(payload), NULL) < 0) {
		printk("CAN -> Zenoh failed: %s\n", key);
		return;
	}
}

/**
 * zenohのsubscribeから受信した時に遅延実行で行う処理
 * キューに入れたデータを取得して、自分のIDが指定されていたら
 * LEDを反転する。
 */
static void zenoh_publish_work_handler(struct k_work *work)
{
	struct can_frame frame = {0};
	uint32_t received_id;
	int ret;

	while (k_msgq_get(&zenoh_sub_queue, &received_id, K_NO_WAIT) == 0) {
		if (led.port) {
			if (received_id == CAN_MESSAGE_ID_SELF) {
				(void)toggle_led(&led);
			}
		}

		frame.id = received_id;
		frame.dlc = 0;
		ret = can_send(can_dev, &frame, K_MSEC(100), NULL, NULL);
		if (ret != 0) {
			printk("Zenoh -> CAN failed for 0x%03x (%d)\n", frame.id, ret);
			return;
		}

		printk("Zenoh -> CAN: 0x%03x (%u bytes)\n", frame.id, frame.dlc);
	}
}

/**
 * CANメッセージを受け取ったときの動作
 * keyからidを抽出して、キューに入れる
 */
static void on_zenoh_sample(z_loaned_sample_t *sample, void *context)
{
	uint32_t id;
	z_view_string_t key;

	ARG_UNUSED(context);

	z_keyexpr_as_view_string(z_sample_keyexpr(sample), &key);
	if (can_id_from_key(z_string_data(z_loan(key)),
			    z_string_len(z_loan(key)), &id) != 0) {
		printk("Zenoh message ignored: invalid key %.*s\n",
		       (int)z_string_len(z_loan(key)),
		       z_string_data(z_loan(key)));
		return;
	}

	if (k_msgq_put(&zenoh_sub_queue, &id, K_NO_WAIT) != 0) {
		return;
	}

	(void)k_work_submit(&zenoh_publish_work);
}

/**
 * ボタン押下時に遅延実行で行う処理.
 * LEDの反転とCANメッセージの送信を行う
 */
static void button_work_handler(struct k_work *work)
{
	bool enabled = 0;

	if (led.port) {
		enabled = toggle_led(&led);
	}

	send_status_can_msg(CAN_MESSAGE_ID_TARGET);
	publish_status(CAN_MESSAGE_ID_TARGET);
}

/**
 * ボタン押下時の処理
 * ログ出力とボタン押下時処理の登録を行う.
 * 割込みのコールバックで時間のかかるCAN送信処理は行えない。
 */
void button_pressed(const struct device *dev, struct gpio_callback *cb,
		    uint32_t pins)
{
	printk("Button pressed at %" PRIu32 "\n", k_cycle_get_32());
	(void)k_work_submit(&button_work);
}

/*
 * main
 */
int main(void)
{
	z_view_keyexpr_t sub_key;
	z_owned_closure_sample_t callback;
	z_owned_subscriber_t subscriber;
	int ret = 0;

	/* CANデバイスのチェック */
	if (!device_is_ready(can_dev)) {
		printk("CAN device is not ready\n");
		return 0;
	}

	const struct can_filter filter = {
		.id = 0,
		.mask = 0,
	};

	/* CANメッセージ受信時に実行するwork の初期化. */
	k_work_init(&can_rx_work, can_rx_work_handler);

	/* 全CAN IDを受信するフィルタを設定 */
	ret = can_add_rx_filter(can_dev, can_received, NULL, &filter);
	if (ret < 0) {
		printk("CAN receive filter registration failed (%d)\n", ret);
		return 0;
	}

	/* !!!!! CAN通信開始 !!!!! */
	ret = can_start(can_dev);
	if (ret != 0) {
		printk("CAN start failed (%d)\n", ret);
		return 0;
	}

	if (!device_is_ready(zenoh_uart_dev)) {
		printk("Zenoh UART device is not ready\n");
		return 0;
	}

	/* zenoh subscribe受信時に実行するwork の初期化. */
	k_work_init(&zenoh_publish_work, zenoh_publish_work_handler);
	/* 接続の識別子(locator)とsubscribeするキーの文字列初期化 */
	char locator[LOCATOR_SIZE];
	char subscribe_key[KEY_SIZE];
	(void)snprintf(locator, sizeof(locator), "serial/%s#baudrate=%d",
		zenoh_uart_dev->name, CONFIG_APP_ZENOH_BAUDRATE);
	(void)snprintf(subscribe_key, sizeof(subscribe_key), "%s/*/tx",
		       APP_ZENOH_KEY_PREFIX);
	printk("Connecting to zenohd at %s\n", locator);

	/* configの設定 */
	z_owned_config_t config;
	z_config_default(&config);
	ret = zp_config_insert(z_loan_mut(config), Z_CONFIG_MODE_KEY, "client");
	if (ret < 0) {
		printk("Failed to insert client key\n");
		z_drop(z_move(config));
		return 0;
	}
	ret = zp_config_insert(z_loan_mut(config), Z_CONFIG_CONNECT_KEY, locator);
	if (ret < 0) {
		printk("Failed to nsert locator\n");
		z_drop(z_move(config));
		return 0;
	}

	/* zenohの通信を開始する */
	ret = z_open(&session, z_move(config), NULL);
	if (ret < 0) {
		printk("Could not open the Zenoh session; check UART and zenohd\n");
		return 0;
	}

	/* トピックにsubscribeする */
	z_view_keyexpr_from_str_unchecked(&sub_key, subscribe_key);
	z_closure(&callback, on_zenoh_sample, NULL, NULL);
	ret = z_declare_subscriber(z_loan(session), &subscriber, z_loan(sub_key),
				 z_move(callback), NULL);
	if (ret < 0) {
		printk("Could not subscribe to %s\n", subscribe_key);
		z_drop(z_move(session));
		return 0;
	}

	if (ret != 0) {
		printk("Zenoh subscriber start failed (%d)\n", ret);
		z_drop(z_move(subscriber));
		z_drop(z_move(session));
		return 0;
	}

	/* ボタンが利用可能かのチェック */
	if (!gpio_is_ready_dt(&button)) {
		printk("Error: button device %s is not ready\n",
		       button.port->name);
		return 0;
	}

	/* ボタンの接続されているGPIOピンを入力モードにする */
	ret = gpio_pin_configure_dt(&button, GPIO_INPUT);
	if (ret != 0) {
		printk("Error %d: failed to configure %s pin %d\n",
		       ret, button.port->name, button.pin);
		return 0;
	}

	/* ボタンの接続されているGPIOピンのエッジ割込み(L->H, H->L時) を有効にする */
	ret = gpio_pin_interrupt_configure_dt(&button,
					      GPIO_INT_EDGE_TO_ACTIVE);
	if (ret != 0) {
		printk("Error %d: failed to configure interrupt on %s pin %d\n",
			ret, button.port->name, button.pin);
		return 0;
	}

	/* ボタン押下時に実行するwork の初期化. */
	k_work_init(&button_work, button_work_handler);
	/* 割込み発生時に button_pressed が呼ばれるように登録 */
	gpio_init_callback(&button_cb_data, button_pressed, BIT(button.pin));
	gpio_add_callback(button.port, &button_cb_data);
	printk("Set up button at %s pin %d\n", button.port->name, button.pin);

	/* LEDのGPIOが有効かの確認 */
	if (led.port && !gpio_is_ready_dt(&led)) {
		printk("Error %d: LED device %s is not ready; ignoring it\n",
		       ret, led.port->name);
		led.port = NULL;
	}
	if (led.port) {
		/* LEDが有効の場合、そのGPIOピンを出力モードに設定 */
		ret = gpio_pin_configure_dt(&led, GPIO_OUTPUT);
		if (ret != 0) {
			printk("Error %d: failed to configure LED device %s pin %d\n",
			       ret, led.port->name, led.pin);
			led.port = NULL;
		} else {
			printk("Set up LED at %s pin %d\n", led.port->name, led.pin);
		}
	}

	printk("Ready: CAN -> %s/<ID>/rx, %s -> CAN\n", APP_ZENOH_KEY_PREFIX, subscribe_key);

	k_sleep(K_FOREVER);

	return 0;
}
```
